## boards/modifier_key/planck/Kconfig
```kconfig
# Planck Split board configuration

if BOARD_PLANCK_LEFT

config ZMK_KEYBOARD_NAME
    default "Planck Split"

config ZMK_SPLIT_ROLE_CENTRAL
    default y

endif # BOARD_PLANCK_LEFT

if BOARD_PLANCK_LEFT || BOARD_PLANCK_RIGHT

config ZMK_SPLIT
    default y

if USB
config USB_NRFX
    default y

config USB_DEVICE_STACK
    default y
endif # USB

endif # BOARD_PLANCK_LEFT || BOARD_PLANCK_RIGHT
```

## boards/modifier_key/planck/Kconfig.planck_left
```kconfig
# Planck Left board configuration

config BOARD_PLANCK_LEFT
    select SOC_NRF52840_QIAA

if BOARD_PLANCK_LEFT
# Any left-side specific configurations
endif
```

## boards/modifier_key/planck/Kconfig.planck_right
```kconfig
# Planck Right board configuration

config BOARD_PLANCK_RIGHT
    select SOC_NRF52840_QIAA

if BOARD_PLANCK_RIGHT
# Any right-side specific configurations
endif
```

## config/boards/arm/planck/Kconfig.board
```kconfig
# Planck Split board configuration

# Copyright (c) 2020 The ZMK Contributors
# SPDX-License-Identifier: MIT

config BOARD_PLANCK_LEFT
    bool "PLANCK ortholinear 4x6 split keyboard (left)"
    depends on SOC_NRF52840_QIAA



config BOARD_PLANCK_RIGHT
    bool "PLANCK ortholinear 4x6 split keyboard (right)"
    depends on SOC_NRF52840_QIAA
```

## config/boards/arm/planck/Kconfig.defconfig
```kconfig
# Planck Split board configuration

# Copyright (c) 2020 The ZMK Contributors
# SPDX-License-Identifier: MIT

if BOARD_PLANCK_LEFT

config ZMK_KEYBOARD_NAME
    default "Planck Split"

config ZMK_SPLIT_ROLE_CENTRAL
    default y

endif # BOARD_PLANCK_LEFT

if BOARD_PLANCK_LEFT || BOARD_PLANCK_RIGHT

config ZMK_SPLIT
    default y

if USB
config USB_DEVICE_STACK
    default y
endif # USB

endif # BOARD_PLANCK_LEFT || BOARD_PLANCK_RIGHT
```

## config/boards/arm/planck/Kconfig.planck_left
```kconfig
# Planck Split board configuration

# Copyright (c) 2020 The ZMK Contributors
# SPDX-License-Identifier: MIT

config BOARD_PLANCK_LEFT
    imply RETAINED_MEM
    imply RETENTION
    imply RETENTION_BOOT_MODE
```

## config/boards/arm/planck/planck_left_defconfig
```kconfig
# SPDX-License-Identifier: MIT
# Planck Split Left (Central) - nRF52840

#
# Clock - 使用内部 RC 振荡器并启用校准
#
CONFIG_CLOCK_CONTROL_NRF_K32SRC_RC=y
CONFIG_CLOCK_CONTROL_NRF_K32SRC_RC_CALIBRATION=y

#
# ZMK Core
#
CONFIG_ZMK_USB=y
CONFIG_ZMK_BLE=y
CONFIG_ZMK_EXT_POWER=y

#
# Split Keyboard - Central 需要设置 BT 连接数
# BT_MAX_CONN = 外围设备数(1) + 蓝牙配置文件数(5) = 6
#
CONFIG_BT_MAX_CONN=6
CONFIG_BT_MAX_PAIRED=6

#
# Build / Flash
#
CONFIG_BUILD_OUTPUT_UF2=y
CONFIG_USE_DT_CODE_PARTITION=y

#
# Storage
#
CONFIG_FLASH=y
CONFIG_FLASH_PAGE_LAYOUT=y
CONFIG_FLASH_MAP=y
CONFIG_NVS=y
CONFIG_SETTINGS_NVS=y

#
# System
#
CONFIG_ARM_MPU=y
CONFIG_MPU_ALLOW_FLASH_WRITE=y

#
# Input - Encoder
#
CONFIG_EC11=y
CONFIG_EC11_TRIGGER_GLOBAL_THREAD=y

#
# GPIO / Pin control
#
CONFIG_GPIO=y
CONFIG_PINCTRL=y

#
# ZMK Studio
#
CONFIG_ZMK_STUDIO=y
CONFIG_ZMK_STUDIO_LOCKING=n
```

## config/boards/arm/planck/planck_right_defconfig
```kconfig
# SPDX-License-Identifier: MIT
# Planck Split Right (Peripheral) - nRF52840

#
# Clock - 使用内部 RC 振荡器并启用校准
#
CONFIG_CLOCK_CONTROL_NRF_K32SRC_RC=y
CONFIG_CLOCK_CONTROL_NRF_K32SRC_RC_CALIBRATION=y

#
# ZMK Core - 右手作为外围设备
#
CONFIG_ZMK_BLE=y
CONFIG_ZMK_EXT_POWER=y

#
# Build / Flash
#
CONFIG_BUILD_OUTPUT_UF2=y
CONFIG_USE_DT_CODE_PARTITION=y

#
# Storage
#
CONFIG_FLASH=y
CONFIG_FLASH_PAGE_LAYOUT=y
CONFIG_FLASH_MAP=y
CONFIG_NVS=y
CONFIG_SETTINGS_NVS=y

#
# System
#
CONFIG_ARM_MPU=y
CONFIG_MPU_ALLOW_FLASH_WRITE=y

#
# Input - Encoder
#
CONFIG_EC11=y
CONFIG_EC11_TRIGGER_GLOBAL_THREAD=y

#
# GPIO / Pin control
#
CONFIG_GPIO=y
CONFIG_PINCTRL=y
```

## config/boards/modifier_key/planck/Kconfig.defconfig
```kconfig
# Planck Split board configuration

if BOARD_PLANCK_LEFT

config ZMK_KEYBOARD_NAME
    default "Planck Split"

config ZMK_SPLIT_ROLE_CENTRAL
    default y

# BT_MAX_CONN = 外围设备数(1) + 蓝牙配置文件数(5) = 6
config BT_MAX_CONN
    default 6

config BT_MAX_PAIRED
    default 6

endif # BOARD_PLANCK_LEFT

if BOARD_PLANCK_LEFT || BOARD_PLANCK_RIGHT

config ZMK_SPLIT
    default y

config BT_CTLR
    default BT

if USB
config USB_NRFX
    default y

config USB_DEVICE_STACK
    default y
endif # USB

endif # BOARD_PLANCK_LEFT || BOARD_PLANCK_RIGHT
```

## config/boards/modifier_key/planck/board.yml
```yaml
boards:
  - name: planck_left
    vendor: modifier_key
    socs:
      - name: nrf52840
        variants:
          - name: zmk
  - name: planck_right
    vendor: modifier_key
    socs:
      - name: nrf52840
        variants:
          - name: zmk
```

## config/boards/modifier_key/planck/planck_left_nrf52840_zmk_defconfig
```kconfig
# SPDX-License-Identifier: MIT
# Planck Split Left (Central) - nRF52840

#
# Clock - 使用内部 RC 振荡器并启用校准
#
CONFIG_CLOCK_CONTROL_NRF_K32SRC_RC=y
CONFIG_CLOCK_CONTROL_NRF_K32SRC_RC_CALIBRATION=y

#
# ZMK Core
#
CONFIG_ZMK_USB=y
CONFIG_ZMK_BLE=y

#
# Build / Flash
#
CONFIG_BUILD_OUTPUT_UF2=y
CONFIG_USE_DT_CODE_PARTITION=y

#
# PWM / LED (hardware capability)
#
CONFIG_PWM=y
CONFIG_LED=y
CONFIG_LED_PWM=y

#
# ZMK Studio
#
CONFIG_ZMK_STUDIO=y
CONFIG_ZMK_STUDIO_LOCKING=n
```

## config/boards/modifier_key/planck/planck_right_nrf52840_zmk_defconfig
```kconfig
# SPDX-License-Identifier: MIT
# Planck Split Right (Peripheral) - nRF52840

#
# Clock - 使用内部 RC 振荡器并启用校准
#
CONFIG_CLOCK_CONTROL_NRF_K32SRC_RC=y
CONFIG_CLOCK_CONTROL_NRF_K32SRC_RC_CALIBRATION=y

#
# ZMK Core - 右手作为外围设备
#
CONFIG_ZMK_BLE=y

#
# Build / Flash
#
CONFIG_BUILD_OUTPUT_UF2=y
CONFIG_USE_DT_CODE_PARTITION=y

#
# PWM / LED (hardware capability)
#
CONFIG_PWM=y
CONFIG_LED=y
CONFIG_LED_PWM=y
```
